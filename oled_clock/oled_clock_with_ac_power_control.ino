#include <Wire.h>
#include <SPI.h>
#include <Adafruit_BME280.h>
#include <OLED_I2C.h>
#include <iarduino_RTC.h>
#include <IRremote.h>
#include <avr/pgmspace.h>

#define minTHI 70.0 // case when AC turn off
#define maxTHI 71.8 // >72 Thermal stress, AC turn on

iarduino_RTC time(RTC_DS1302, 7, 9, 8);
OLED  myOLED(SDA, SCL, 8);
Adafruit_BME280 bme;

extern uint8_t MegaNumbers[];
extern uint8_t SmallFont[];

IRsend irsend;
int khz = 38;
const unsigned int signal_turn_on[] PROGMEM = {3536, 1716, 460, 408, 468, 1276, 468, 404, 464, 388, 484, 408, 468,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 1280, 464};
const unsigned int signal_turn_off[] PROGMEM = {3516, 1716, 464, 408, 464, 1280, 464, 404, 468, 404, 468, 404, 468,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 1280, 468};

void setup() {
  delay(300);
  time.begin(); // time.settime(00, 20, 01, 23, 11, 17, 4);

  bme.begin(0x76);
  delay(100);

  myOLED.begin();
}

void loop() {
  float temperature = bme.readTemperature();
  float humidity = bme.readHumidity();
  float pressure = bme.readPressure() / 133.3;

  double c;

  String temperatureString = String(uint8_t(temperature)) + "," + String(uint8_t(modf(temperature, &c) * 10)) + "  C";
  String humidityString = String(uint8_t(ceil(humidity))) + "%";
  String pressureString = String(int(ceil(pressure))) + "mm";

  myOLED.clrScr();

  String date = time.gettime("d.m.Y");
  String H = time.gettime("H");
  String i = time.gettime("i");
  String s = time.gettime("s");

  String dayOfWeek = time.gettime("D");

  myOLED.setFont(SmallFont);
  myOLED.print(dayOfWeek, LEFT, 0);

  myOLED.setFont(MegaNumbers);
  myOLED.print(H, 4, 12);
  myOLED.print(i, 75, 12);

  myOLED.setFont(SmallFont);
  myOLED.print(date, RIGHT, 0);

  myOLED.setFont(SmallFont);
  myOLED.print(s, CENTER, 30);

  myOLED.setFont(SmallFont);
  myOLED.print(temperatureString, RIGHT, 57);

  myOLED.setFont(SmallFont);
  myOLED.print((char*)"o", 115, 55);

  myOLED.setFont(SmallFont);
  myOLED.print(humidityString, CENTER, 57);

  myOLED.setFont(SmallFont);
  myOLED.print(pressureString, LEFT, 57);

  myOLED.update();
  delay(100);

  toggleAcPower(temperature, humidity);
}

float getTHI(float temperature, float humidity)
{
  float THI = (1.8 * temperature + 32) - ((0.55 - 0.0055 * humidity) * (1.8 * temperature - 26));

  return THI;
}

void toggleAcPower(float temperature, float humidity)
{
  float THI = getTHI(temperature, humidity);

  if (THI <= minTHI) {
    turnOffAC();
    return;
  }

  int second = String(time.gettime("s")).toInt();

  if (0 == second) {
    if (THI >= maxTHI) {
      turnOnAC();
      return;
    }

  }

  delay(1000);
}

void turnOnAC() {
  int size = sizeof(signal_turn_on) / sizeof(int);
  unsigned int buffer[size];

  for (int i = 0; i < size; i++) {
    buffer[i] = pgm_read_dword(&signal_turn_on[i]);
  }

  irsend.sendRaw(buffer, size, khz);
}

void turnOffAC() {
  int size = sizeof(signal_turn_off) / sizeof(int);
  unsigned int buffer[size];

  for (int i = 0; i < size; i++) {
    buffer[i] = pgm_read_dword(&signal_turn_off[i]);
  }

  irsend.sendRaw(buffer, size, khz);
}
