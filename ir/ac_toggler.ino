#include <Wire.h>
#include <SPI.h>
#include <Adafruit_BME280.h>
#include <IRremote.h>
#include <avr/pgmspace.h>

#define minTemperature 25.65 // case when AC turn off
#define maxTemperature 25.95 // Thermal stress, AC turn on

bool AC_ON = false;
bool AC_OFF = false;

int modeAnalogPin = 3;

Adafruit_BME280 bme;

IRsend irsend;
int khz = 38;

// Signals correspond to temperatures range from  24 °C to  19 °C
const unsigned int Signals_TURN_ON[6][439] PROGMEM = {
  {3548, 1688, 440, 432, 440, 1304, 492, 380, 492, 380, 440, 432, 440,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 1300, 444},
  {3496, 1736, 440, 432, 440, 1332, 412, 432, 440, 460, 412, 432, 440,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 1300, 444},
  {3496, 1736, 444, 428, 444, 1300, 444, 428, 444, 428, 444, 428, 444,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 1304, 440},
  {3496, 1736, 444, 428, 444, 1300, 444, 428, 444, 428, 440, 432, 444,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 1300, 444},
  {3496, 1736, 444, 428, 468, 1276, 440, 432, 444, 428, 444, 428, 440,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 1304, 440},
  {3496, 1740, 440, 432, 440, 1300, 444, 432, 440, 432, 440, 428, 416,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 1300, 444}
};

const unsigned int Signals_TURN_OFF[] PROGMEM = {3548, 1688, 492, 380, 440, 1300, 444, 428, 496, 376, 444, 432, 440,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 1304, 440};

unsigned int mode = 2; // 22 °C
unsigned int maxMode = 5; // 19 °C
float maxModeTemperature = 24;

void setup() {
  bme.begin(0x76);
  delay(100);

  Serial.begin(9600);
}

void loop() {
  float temperature = bme.readTemperature();

  Serial.println("--------");
  Serial.print("Temperature: ");
  Serial.println(temperature);
  Serial.print("Mode temperature: ");
  Serial.println(getTemperatureOfMode());

  unsigned int expectedMode = getMode();

  if (expectedMode != mode) {
    setMode(expectedMode);

  } else {
    toggleAcPower(temperature);
  }

  delay(1000);
}

void toggleAcPower(float temperature)
{
  if (temperature <= minTemperature) {
    if (AC_OFF == false) {
      turnOffAC();
      AC_OFF = true;
      AC_ON = false;
      return;
    }
  }

  if (temperature >= maxTemperature) {
    if (AC_ON == false) {
      turnOnAC(mode);
      AC_ON = true;
      AC_OFF = false;
      return;
    }
  }
}

void turnOnAC(unsigned int mode) {
  if (mode > maxMode) {
    Serial.println("ON AC: incorrect mode");
    return;
  }

  int size = sizeof(Signals_TURN_ON[mode]) / sizeof(int);
  unsigned int buffer[size];

  for (int i = 0; i < size; i++) {
    buffer[i] = pgm_read_dword(&Signals_TURN_ON[mode][i]);
  }

  irsend.sendRaw(buffer, size, khz);
  Serial.println("ON AC");
}

void turnOffAC() {
  int size = sizeof(Signals_TURN_OFF) / sizeof(int);
  unsigned int buffer[size];

  for (int i = 0; i < size; i++) {
    buffer[i] = pgm_read_dword(&Signals_TURN_OFF[i]);
  }

  irsend.sendRaw(buffer, size, khz);
  Serial.println("OFF AC");
}

unsigned int getMode()
{
  unsigned int value = analogRead(modeAnalogPin);
  unsigned int mode = map(value, 0, 1023, 0, maxMode);

  return mode;
}

void setMode(unsigned int value)
{
  mode = value;
  turnOnAC(mode);
}

unsigned int getTemperatureOfMode()
{
  return maxModeTemperature - mode;
}


